/**
  ******************************************************************************
  * @project Alpha One Flight Control System 
  * @author  Dr.Sheng Team
  * @version V1.0.0
  * @date    12-April-2019
  * @brief   com_test.cpp
  ******************************************************************************
**/	

#include "main.h"

/**
  ******************************************************************************
  * @test		 Optical Flow Module 
  * @author  Ziwen LIU
  * @date    18-April-2019
  ******************************************************************************
**/
const static uint8_t sensor_cfg[]={
//地址, 数据
  0x12, 0x80, 
  0x11, 0x30, 
  0x1b, 0x06, 
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  0x98, 0x1a
};

TEST_OPTICAL_FLOW optical_flow_module;

bool test_flag=false;


bool TEST_OPTICAL_FLOW::init(void)
{
	//初始化1：上电
	hal_uart.com4_send_byte(0xAA);//开启配置指令，模块无返回
	delay.ms(10);
	//初始化2：模块内部参数配置，成功则会接收到0xAB，0x00，0xAB
	hal_uart.com4_send_byte(0xAB);//模块内部参数配置指令，模块返回0xAB
	hal_uart.com4_send_byte(0x96);
	hal_uart.com4_send_byte(0x26);
	hal_uart.com4_send_byte(0xBC);
	hal_uart.com4_send_byte(0x50);//四个内部参数指令，全部发送完后模块返回0x00成功（0x01无应答，0x02校验错误）
	hal_uart.com4_send_byte(0x5C);//四个内部参数指令的异或值，为XOR校验
	delay.ms(10);
	if((test_temp[0]!=0xAB)||(test_temp[1]!=0x00)||(test_temp[2]!=0xAB))
		return false;
	//初始化3：
	uint16_t length;
	length=sizeof(sensor_cfg);
	for(uint16_t test_i=0; test_i<length; test_i+=2)
	{
		static uint16_t j=0;
		j+=3;
		stage3_init(sensor_cfg[test_i], sensor_cfg[test_i+1]);
		delay.ms(10);
		if((test_temp[j]!=0xBB)||(test_temp[j+1]!=0x00)||(test_temp[j+2]!=0xBB))
			return false;
	}
	//初始化4：
	hal_uart.com4_send_byte(0xDD);//关闭配置指令，模块无返回值
	return true;
}	

void TEST_OPTICAL_FLOW::stage3_init(uint8_t address, uint8_t data)
{
	hal_uart.com4_send_byte(0xBB);//传感器参数配置指令，模块返回0xBB
	hal_uart.com4_send_byte(0xDC);
	hal_uart.com4_send_byte(address);
	hal_uart.com4_send_byte(data);
	hal_uart.com4_send_byte(0xDC^address^data);//四个内部参数指令，全部发送完后模块返回0x00成功（0x01无应答，0x02校验错误）
	
}


uint8_t optical_flow_data[14]={0};

bool optical_flow_module_data_protocol(uint8_t rcvdata)
{
	static uint8_t rcvPart = 0;
	static uint8_t rcvDataNo = 0;
	static uint8_t rcvDataLen = 0;
	static uint8_t rcvingBuf[13];

	switch(rcvPart)
	{
			case 0:
				if(rcvdata == 0xFE)
				{
					rcvPart = 1;
					rcvingBuf[rcvDataNo] = 0xFE;
					rcvDataNo++;
				}
				break;
			
			case 1:
				if(rcvdata == 0x0A)
				{
					rcvPart =2;
					rcvingBuf[rcvDataNo] = 0x0A;
					rcvDataNo++;
				}
				else
				{
					rcvPart = 0;
					rcvDataNo =0;
				}
				break;

			case 2:
				rcvDataLen = 12;//rcvDataLen指的是除了两个数据头之外的，其他数据长度
				rcvPart = 3;
				rcvingBuf[rcvDataNo] = rcvdata;
				rcvDataNo++;
				break;
			
			case 3:
				rcvingBuf[rcvDataNo] = rcvdata;
				rcvDataNo++;
				rcvDataLen--;
				if(rcvDataLen == 0)
				{
					rcvPart = 4;
				}
				break;

			case 4:
				for(uint8_t k = 0 ;k < 14 ; k++)
				{
					optical_flow_data[k] = rcvingBuf[k];
				}
				optical_flow_module_data_handle();
				rcvPart = 0;
				rcvDataNo = 0;
				return true;

			default:
				break;
		}
	return false;
}

int16_t flow_x_integral=0;
int16_t flow_y_integral=0;
uint16_t integration_timespan=0;
uint16_t ground_distance=0;
uint8_t valid=0;
uint8_t version=0;


void optical_flow_module_data_handle(void)
{
	uint8_t _xor=0;
	for(uint8_t i=2;i<12;i++)_xor^=optical_flow_data[i];
	if(_xor!=optical_flow_data[12])return;
	
	else
	{
		flow_x_integral=COM_Joint_Two8Bit_To_16Bit(optical_flow_data[3],optical_flow_data[2]);
		flow_y_integral=COM_Joint_Two8Bit_To_16Bit(optical_flow_data[5],optical_flow_data[4]);
		integration_timespan=COM_Joint_Two8Bit_To_16Bit(optical_flow_data[7],optical_flow_data[6]);
		ground_distance=COM_Joint_Two8Bit_To_16Bit(optical_flow_data[9],optical_flow_data[8]);
		valid=optical_flow_data[10];
		version=optical_flow_data[11];
	}
}



